## conf/machine/sf8008m.conf
```bitbake
#@TYPE: Machine
#@NAME: sf8008m
#@DESCRIPTION: Machine configuration for the sf8008m

EXTRA_OECONF_append_pn-enigma2 = "--with-lcddev=/dev/null --with-alphablendingacceleration=always --with-blitaccelerationthreshold=250  --with-fillaccelerationthreshold=190000"

MACHINE_FEATURES += " textlcd 7segment blindscan dvb-c hisil mali transcoding emmc"
OPENPLI_FEATURES += " qtplugins"
DISTRO_FEATURES_remove = "x11 wayland"

CHIPSET = "Hi3798Mv200"

require conf/machine/include/octagon-hisi.inc
```
